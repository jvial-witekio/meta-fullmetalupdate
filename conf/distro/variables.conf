## conf/distro/variables.conf
```bitbake
APP_DIRECTORY="/apps"
PRODUCT_ID = "${MACHINE}"
CONTAINERS_DIRECTORY = "${TOPDIR}/tmp/fullmetalupdate-containers/deploy/containers/${MACHINE}"

# Temporary workaround to make OSTree to use libsoup instead of libcurl
BBMASK += "meta-updater/recipes-extended/ostree/ostree_%.bbappend"
```
